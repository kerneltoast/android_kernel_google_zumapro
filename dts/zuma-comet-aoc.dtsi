// SPDX-License-Identifier: GPL-2.0-only
/*
 * AoC device tree source
 *
 * Copyright 2023 Google,LLC.
 */


&aoc_vsync_pins {
	samsung,pins = "gpp3-1", "gpp5-1", "gpp7-1", "gpp9-1", "gpp15-1";
	samsung,pin-function = <EXYNOS_PIN_FUNC_2>;
};

