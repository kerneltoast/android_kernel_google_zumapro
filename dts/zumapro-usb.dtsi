// SPDX-License-Identifier: GPL-2.0-only
/*
 * USB device tree source code for Zuma Pro SoC
 *
 * Copyright 2023 Google LLC.
 */
#include "google-dts-zuma/zuma-usb.dtsi"

&usbdrd_phy0 {
		phy_eusb_version = <0x701>;
};

