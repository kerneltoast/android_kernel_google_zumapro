// SPDX-License-Identifier: GPL-2.0-only
/*
 * Ripcurrent24 board device tree source
 *
 * Copyright 2022 Google LLC
 */

/dts-v1/;
/plugin/;

#include "zuma-24-common.dtsi"
#include "zumapro/zumapro-board-ignss.dtsi"
#include "zuma/zuma-ripcurrent24-ultrasonic-udfps.dtsi"
#include "zuma-ripcurrent24-battery.dtsi"
#include "zuma/zuma-board-bcl.dtsi"
#include "zuma/zuma-ripcurrent-charging.dtsi"
#include "zuma/zuma-ripcurrent-usecases.dtsi"
#include "zuma/zuma-ripcurrent24-display.dtsi"
#include "zuma/zuma-ripcurrent-wcharger.dtsi"
#include "zuma/zuma-ripcurrent-typec.dtsi"

/ {
	board_id = <0x40701>;
	board_rev = <0x010000>;
	fragment@boardbase {
		target-path = "/";
		__overlay__ {
			model = "ZUMA Ripcurrent24 board based on ZUMA";
			compatible = "google,ZUMA Ripcurrent24", "google,ZUMA";
		};
	};
};
