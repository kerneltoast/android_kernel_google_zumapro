// SPDX-License-Identifier: GPL-2.0-only
/*
 * Zuma24 board device tree source
 *
 * Copyright 2023 Google LLC
 */

#include "zuma/zuma-common.dtsi"

#include "zuma/zuma-ripcurrent-battery.dtsi"
#include "zuma/zuma-ripcurrent-camera-pmic.dtsi"
#include "zuma/zuma-ripcurrent-camera.dtsi"
#include "zuma/zuma-ripcurrent-display.dtsi"
#include "zuma/zuma-ripcurrent-gsa-gsc.dtsi"
#include "zuma/zuma-ripcurrent-pmic.dtsi"
#include "zuma/zuma-ripcurrent-touch.dtsi"
#include "zuma/zuma-ripcurrent-usb.dtsi"
#include "zuma/zuma-board-wlan.dtsi"
#include "zuma-ripcurrent-cp-s5400-sit.dtsi"
#include "zuma/zuma-board-bluetooth.dtsi"
#include "zuma/zuma-board-ese.dtsi"
#include "zuma/zuma-board-nfc.dtsi"
#include "zuma/zuma-board-udfps.dtsi"
#include "zuma/zuma-ripcurrent-audio.dtsi"
#include "zuma/zuma-board-pcie.dtsi"
#include "zuma/zuma-board-pcie-cp-s5400-a0.dtsi"
#include "zuma/zuma-ripcurrent-haptics.dtsi"
#include "zuma/zuma-board-uwb.dtsi"
#include "zuma/zuma-ripcurrent-thermal.dtsi"
#include "zuma/zuma-ripcurrent-sbbm.dtsi"
#include "zuma/zuma-ripcurrent-bluetooth.dtsi"
#include "zuma/zuma-ripcurrent-bluetooth-offmode.dtsi"
#include "zuma/zuma-typec.dtsi"

