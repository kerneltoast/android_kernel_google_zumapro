// SPDX-License-Identifier: GPL-2.0-only
/*
 * Zumapro board device tree source
 *
 * Copyright 2024 Google LLC
 */

&spmi_bb {
	clk-gpio = <&gpa3 0 GPIO_ACTIVE_HIGH>;
	dat-gpio = <&gpa3 1 GPIO_ACTIVE_HIGH>;
};
