// SPDX-License-Identifier: GPL-2.0-only
/*
 * ZumaPro with Sapwood board device tree source
 *
 * Copyright 2023 Google LLC
 */

#include "zumapro/zumapro-board-common.dtsi"
#include "zumapro/zumapro-ripcurrentpro-bcl-sapwood.dtsi"
#include "zuma/zuma-ripcurrent-camera-pmic.dtsi"
#include "zuma/zuma-ripcurrent-camera.dtsi"
#include "zumapro/zumapro-ripcurrentpro-usb.dtsi"
/*
#include "zuma-24-common.dtsi"
#include "zumapro/zumapro-board-gps.dtsi"
#include "zuma-ripcurrent24-ultrasonic-udfps.dtsi"
*/

#include "zuma/zuma-ripcurrent-battery.dtsi"
#include "zuma/zuma-typec.dtsi"
#include "zuma/zuma-ripcurrent-gsa-gsc.dtsi"

/* Sapwood Config */
#include "zuma-ripcurrent24-sapwood-caimito-battery.dtsi"
#include "zuma-ripcurrent24-sapwood-caimito-charging.dtsi"
#include "zuma-ripcurrent24-sapwood-caimito-typec.dtsi"
#include "zuma-ripcurrent24-sapwood-wcharger.dtsi"
#include "zuma-caimito-usecases-evt.dtsi"
