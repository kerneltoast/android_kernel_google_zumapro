// SPDX-License-Identifier: GPL-2.0-only
/*
 * Caiman board device tree source
 *
 * Copyright 2023 Google LLC
 */

/dts-v1/;
/plugin/;

#define ZUMA_BMS_I2CM 1
#define ZUMA_BMS_PROTO_EVT10_MODEL
#define ZUMA_BMS_ENABLE_CHG_PROFILE_SWITCH
#include "zumapro-caimito-common.dtsi"
#include "google-dts-zumapro/zumapro-board-cp-s5400-sit-pre-dvt.dtsi"
#include "zumapro-caiman-common.dtsi"
#include "google-dts-zumapro/zumapro-phone-gps.dtsi"
#include "zumapro-caimito-wifi-4390a0.dtsi"

/ {
	board_id = <0x60903>;
	board_rev = <0x010005>;
	fragment@boardbase {
		target-path = "/";
		__overlay__ {
			model = "ZUMA PRO CAIMAN EVT 1.0 Broadcom GNSS w/ I2CM board based on ZUMA PRO";
			compatible = "google,ZUMA PRO CAIMAN", "google,ZUMA PRO";
		};
	};
};
