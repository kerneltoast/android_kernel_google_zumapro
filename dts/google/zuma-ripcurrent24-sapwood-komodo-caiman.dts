// SPDX-License-Identifier: GPL-2.0-only
/*
 * Komodo Sapwood board device tree source
 *
 * Copyright 2023 Google LLC
 */

/dts-v1/;
/plugin/;

#include "zuma-ripcurrent24-sapwood-caimito-common.dtsi"
#include "google-dts-zumapro/zumapro-board-gps.dtsi"
#include "zuma-ripcurrent24-ultrasonic-udfps.dtsi"
#include "zuma-ripcurrent24-sapwood-komodo-caiman-common.dtsi"
#include "zuma-komodo-wcharger.dtsi"

/ {
	board_id = <0x40701>;
	board_rev = <0x010001>;
	fragment@boardbase {
		target-path = "/";
		__overlay__ {
			model = "ZUMA Ripcurrent24 Sapwood KOMODO/CAIMAN configuration board based on ZUMA";
			compatible = "google,ZUMA Ripcurrent24 Sapwood KOMODO/CAIMAN", "google,ZUMA";
		};
	};
};
