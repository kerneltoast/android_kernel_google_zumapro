// SPDX-License-Identifier: GPL-2.0-only
/*
 * Komodo board device tree source
 *
 * Copyright 2023 Google LLC
 */

/dts-v1/;
/plugin/;

#define ZUMA_BMS_PROTO_EVT10_MODEL
#define ESIM_NO_CHIP_ENABLE_PIN
#include "zuma-caimito-common.dtsi"
#include "zuma-komodo-common.dtsi"
#include "google-dts-zumapro/zumapro-phone-gps.dtsi"
#include "zuma-komodo-wifi-4390a0.dtsi"

/ {
	board_id = <0x40802>;
	board_rev = <0x010002>;
	fragment@boardbase {
		target-path = "/";
		__overlay__ {
			model = "ZUMA KOMODO Proto 1.0 Broadcom GNSS and MAG3 board based on ZUMA";
			compatible = "google,ZUMA KOMODO", "google,ZUMA";
		};
	};
};
