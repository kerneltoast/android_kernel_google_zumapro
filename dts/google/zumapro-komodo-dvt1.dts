// SPDX-License-Identifier: GPL-2.0-only
/*
 * Komodo board device tree source
 *
 * Copyright 2023 Google LLC
 */

/dts-v1/;
/plugin/;

#include "zumapro-caimito-common.dtsi"
#include "zumapro-komodo-common.dtsi"
#include "google-dts-zuma/max777xx-fwupdate.dtsi"
#include "google-dts-zumapro/zumapro-phone-ignss.dtsi"
#include "zumapro-caimito-cp-features.dtsi"

/ {
	board_id = <0x60804>;
	board_rev = <0x010000>;
	fragment@boardbase {
		target-path = "/";
		__overlay__ {
			model = "ZUMA PRO KOMODO DVT 1.0 board based on ZUMA PRO";
			compatible = "google,ZUMA PRO KOMODO", "google,ZUMA PRO";
		};
	};
};
