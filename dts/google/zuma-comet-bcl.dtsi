// SPDX-License-Identifier: GPL-2.0-only
/*
 * Google Zuma24/Comet bcl device tree source
 *
 * Copyright (c) 2024 Google, LLC
 *		https://www.google.com
 */

#include "google-dts-zumapro/zumapro-board-bcl.dtsi"

&pinctrl_11 {
	bcl_rffe_modem: bcl-rffe-modem {
		samsung,pins = "gpp11-0";
		samsung,pin-function = <EXYNOS_PIN_FUNC_OUTPUT>;
	};
	bcl_batoilo_modem: bcl-batoilo-modem {
		samsung,pins = "gpp13-0";
		samsung,pin-function = <EXYNOS_PIN_FUNC_OUTPUT>;
	};
};

&google_mitigation {
	google,ifpmic = <M77779>;
	google,charger = <&max77779_chg>;
	google,pmic = <&max77779_pmic>;
	google,power-supply = <&max77779_fg>;
	batoilo_lower = <1800>;
	batoilo_upper = <8000>;
	batoilo2_lower = <3800>;
	batoilo2_upper = <10000>;
	batoilo_wlc_trig_lvl = <2200>;
	batoilo2_wlc_trig_lvl = <5200>;
	batoilo_trig_lvl = <5000>;
	batoilo2_trig_lvl = <8000>;
	batoilo_bat_open_to = <0x8>;    /* 36ms */
	batoilo2_bat_open_to = <0x3>;   /* 12ms */
	batoilo_rel = <0x3>;   /* 10ms */
	batoilo2_rel = <0x3>;   /* 10ms */
	batoilo_det = <0x1A>;   /* 34ms DEBOUNCE to VDROOP */
	batoilo2_det = <0x1>;   /* 30us DEBOUNCE to VDROOP */
	batoilo_int_det = <0x2>;   /* 5ms */
	batoilo2_int_det = <0x1>;   /* 30us */
	batoilo_int_rel = <0x2>;   /* 1ms */
	batoilo2_int_rel = <0x3>;   /* 10ms */
	uvlo1_rel = <0x2>;   /* 10ms */
	uvlo2_rel = <0x2>;   /* 10ms */
	uvlo1_det = <0x1>;   /* 30us */
	uvlo2_det = <0x1>;   /* 30us */
	evt_cnt_enable = <0x1>;
	evt_cnt_rate = <0x0>;   /* 16k */
	gpios = <&gpa9 5 GPIO_ACTIVE_HIGH>,		/* VDROOP1 */
		<&gpa9 6 GPIO_ACTIVE_HIGH>,		/* VDROOP2 */
		<&gpp11 0 GPIO_ACTIVE_HIGH>,
		<&gpp13 0 GPIO_ACTIVE_HIGH>;
	rffe_channel = <11>;
	cpu0_cluster = <0>;
	cpu1_cluster = <4>;
	cpu2_cluster = <8>;
	pinctrl-names = "bcl-rffe-modem", "bcl-batoilo-modem";
	pinctrl-0 = <&bcl_rffe_modem>;
	pinctrl-1 = <&bcl_batoilo_modem>;
	interrupt-parent = <&max77779_pmic_irq>;
	interrupts = <6 IRQ_TYPE_LEVEL_LOW>;
};
