// SPDX-License-Identifier: GPL-2.0-only
/*
 * Comet board device tree source
 *
 * Copyright 2024 Google LLC
 */

/dts-v1/;
/plugin/;

#include "zumapro-comet-common.dtsi"
#include "zumapro-comet-usecases.dtsi"
#include "zuma-comet-typec.dtsi"
#include "google-dts-zumapro/zumapro-board-cp-s5400-sit.dtsi"
#include "google-dts-zumapro/zumapro-board-pcie-cp-s5400-a1.dtsi"
#include "google-dts-zuma/zuma-cp-s5400-phone-gnss.dtsi"
#include "zuma-comet-touch.dtsi"
#include "zuma-comet-outer-touch.dtsi"
#include "zuma-comet-audio.dtsi"
#include "zuma-comet-fingerprint.dtsi"
#include "zuma-comet-camera-pmic.dtsi"
#include "zuma-comet-camera.dtsi"
#include "zuma-comet-wlan.dtsi"
#include "zuma-comet-gnss-samsung.dtsi"
#include "zuma-comet-wcharger-evt.dtsi"
#include "google-dts-zuma/max777xx-fwupdate.dtsi"
#include "zumapro-comet-evt1_1-battery.dtsi"

/ {
	board_id = <0x60606>;
	board_rev = <0x010000>;
	fragment@boardbase {
		target-path = "/";
		__overlay__ {
			model = "ZUMA PRO COMET MP board based on ZUMA PRO";
			compatible = "google,ZUMA PRO COMET", "google,ZUMA PRO";
		};
	};
};
