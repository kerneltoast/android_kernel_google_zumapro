// SPDX-License-Identifier: GPL-2.0-only
/*
 * Battery device tree entries
 *
 * Copyright 2023 Google LLC
 *
 */

max77779,config {

	/* KM4_ATL_RC2_BC79_2mOhm_3501_1_071723_20231002.model.ini.txt, b/303120295#comment1 */
	max77779,atl-1k {
		max77779,batt-id-kohm = <1>;
		max77779,model-version = <7>;
		max77779,force-reset-model-data;
		max77779,fg-model = /bits/ 16 <
 			0xa520 0xb6c0 0xb800 0xba50 0xbbc0 0xbd00 0xbea0 0xc020
			0xc1c0 0xc360 0xc760 0xcaf0 0xce60 0xd1e0 0xd840 0xde30
			0x0100 0x0c00 0x0d00 0x14f0 0x0ed0 0x1210 0x1430 0x0cb0
			0x0cf0 0x06f0 0x07d0 0x06e0 0x06f0 0x06f0 0x06b0 0x06b0
		>;
		max77779,fg-params = /bits/ 16 <
			/* 0x00C0 */	0xc1b0	/* nNVCfg0 */
			/* 0x00B6 */	0x043c	/* RelaxCFG */
			/* 0x009F */	0x2606	/* nLearnCFG */
			/* 0x000C */	0x4207	/* Config */
			/* 0x00AB */	0x0080	/* Config2 */
			/* 0x00BC */	0x5f00	/* nFullSOCthr */
			/* 0x00A9 */	0x07d6	/* nFullCAPRep */
			/* 0x00B3 */	0x07d6	/* nDesignCap */
			/* 0x0046 */	0x0C80	/* dPacc */
			/* 0x00A5 */	0x07d6	/* nFullCAPNom */
			/* 0x00C6 */	0xa55a	/* nV_empty */
			/* 0x00A0 */	0x2f00	/* nQRTable00 */
			/* 0x00A1 */	0x1700	/* nQRTable10 */
			/* 0x00A2 */	0x0b00	/* nQRTable20 */
			/* 0x00A3 */	0x0900	/* nQRTable30 */
			/* 0x00A6 */	0x0560	/* nRCOMP0 */
			/* 0x00A7 */	0x2202	/* nTempCo */
			/* 0x009C */	0x0278	/* nIChgTerm */
			/* 0x00B2 */	0x3850	/* nMiscCFG */
			/* 0x009E */	0x0400	/* nModelCfg */
			/* 0x00CA */	0xC8FF	/* nThermCfg */
			/* 0x009D */	0xCEA4	/* nFilterCfg */
		>;
	};

	/* KM4_COS_RC2_BC79_2mOhm_3502_2_071823_20231002.model.ini.txt, b/303120295#comment1 */
	max77779,cos-2k {
		max77779,batt-id-kohm = <2>;
		max77779,model-version = <7>;
		max77779,force-reset-model-data;
		max77779,fg-model = /bits/ 16 <
			0xa510 0xb6d0 0xb880 0xba30 0xbbe0 0xbdc0 0xbef0 0xc060
			0xc400 0xc750 0xcaf0 0xce70 0xd1e0 0xd8c0 0xdaa0 0xde60
			0x0120 0x0c20 0x0d30 0x1010 0x0f60 0x1240 0x11a0 0x0ce0
			0x06d0 0x06f0 0x06d0 0x0740 0x06d0 0x09d0 0x0680 0x0680
		>;
		max77779,fg-params = /bits/ 16 <
			/* 0x00C0 */	0xc1b0	/* nNVCfg0 */
			/* 0x00B6 */	0x043c	/* RelaxCFG */
			/* 0x009F */	0x2606	/* nLearnCFG */
			/* 0x000C */	0x4207	/* Config */
			/* 0x00AB */	0x0080	/* Config2 */
			/* 0x00BC */	0x5f00	/* nFullSOCthr */
			/* 0x00A9 */	0x07d6	/* nFullCAPRep */
			/* 0x00B3 */	0x07d6	/* nDesignCap */
			/* 0x0046 */	0x0C80	/* dPacc */
			/* 0x00A5 */	0x07d6	/* nFullCAPNom */
			/* 0x00C6 */	0xa55a	/* nV_empty */
			/* 0x00A0 */	0x3400	/* nQRTable00 */
			/* 0x00A1 */	0x1780	/* nQRTable10 */
			/* 0x00A2 */	0x0900	/* nQRTable20 */
			/* 0x00A3 */	0x0880	/* nQRTable30 */
			/* 0x00A6 */	0x04e0	/* nRCOMP0 */
			/* 0x00A7 */	0x1c02	/* nTempCo */
			/* 0x009C */	0x0278	/* nIChgTerm */
			/* 0x00B2 */	0x3850	/* nMiscCFG */
			/* 0x009E */	0x0400	/* nModelCfg */
			/* 0x00CA */	0xC8FF	/* nThermCfg */
			/* 0x009D */	0xCEA4	/* nFilterCfg */
		>;
	};

	/* KM4_LWN_RC2_BC79_2mOhm_3503_1_071723_20231002.model.ini.txt, b/303120295#comment1 */
	max77779,lwn-4k {
		max77779,batt-id-kohm = <4>;
		max77779,model-version = <7>;
		max77779,force-reset-model-data;
		max77779,fg-model = /bits/ 16 <
			0xa500 0xb760 0xb8c0 0xbaa0 0xbd30 0xbd90 0xbe30 0xbf20
			0xbf60 0xc0c0 0xc280 0xc3e0 0xcac0 0xd050 0xd800 0xddc0
			0x0130 0x1200 0x0d30 0x0e30 0x2b10 0x1020 0x1240 0x2220
			0x0eb0 0x0ef0 0x05f0 0x07f0 0x06c0 0x06f0 0x0670 0x0670
		>;
		max77779,fg-params = /bits/ 16 <
			/* 0x00C0 */	0xc1b0	/* nNVCfg0 */
			/* 0x00B6 */	0x043c	/* RelaxCFG */
			/* 0x009F */	0x2606	/* nLearnCFG */
			/* 0x000C */	0x4207	/* Config */
			/* 0x00AB */	0x0080	/* Config2 */
			/* 0x00BC */	0x5f00	/* nFullSOCthr */
			/* 0x00A9 */	0x07d6	/* nFullCAPRep */
			/* 0x00B3 */	0x07d6	/* nDesignCap */
			/* 0x0046 */	0x0C80	/* dPacc */
			/* 0x00A5 */	0x07d6	/* nFullCAPNom */
			/* 0x00C6 */	0xa55a	/* nV_empty */
			/* 0x00A0 */	0x2f8e	/* nQRTable00 */
			/* 0x00A1 */	0x1a00	/* nQRTable10 */
			/* 0x00A2 */	0x0f00	/* nQRTable20 */
			/* 0x00A3 */	0x0b00	/* nQRTable30 */
			/* 0x00A6 */	0x0550	/* nRCOMP0 */
			/* 0x00A7 */	0x1f02	/* nTempCo */
			/* 0x009C */	0x0278	/* nIChgTerm */
			/* 0x00B2 */	0x3850	/* nMiscCFG */
			/* 0x009E */	0x0400	/* nModelCfg */
			/* 0x00CA */	0xC8FF	/* nThermCfg */
			/* 0x009D */	0xCEA4	/* nFilterCfg */
		>;
	};
};
