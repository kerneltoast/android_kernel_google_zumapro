// SPDX-License-Identifier: GPL-2.0-only
/*
 * Comet board device tree source
 *
 * Copyright 2024 Google LLC
 */

/dts-v1/;
/plugin/;

#include "zumapro-comet-common.dtsi"
#include "zumapro-comet-usecases.dtsi"
#include "zuma-comet-typec.dtsi"
#include "google-dts-zumapro/zumapro-board-cp-s5400-sit.dtsi"
#include "google-dts-zumapro/zumapro-board-cp-s5400-sit-pre-dvt.dtsi"
#include "google-dts-zumapro/zumapro-board-pcie-cp-s5400-a1.dtsi"
#include "google-dts-zumapro/zumapro-phone-gps.dtsi"
#include "zuma-comet-touch.dtsi"
#include "zuma-comet-outer-touch.dtsi"
#include "zuma-comet-audio.dtsi"
#include "zuma-comet-fingerprint.dtsi"
#include "zuma-comet-camera-pmic.dtsi"
#include "zuma-comet-camera.dtsi"
#include "zuma-comet-wlan.dtsi"
#include "zuma-comet-wcharger-evt.dtsi"
#include "zumapro-comet-wifi-4390a0.dtsi"

/ {
	board_id = <0x60603>;
	board_rev = <0x010005>;
	fragment@boardbase {
		target-path = "/";
		__overlay__ {
			model = "ZUMA PRO COMET EVT 1.0 Broadcom GNSS SDC board based on ZUMA PRO";
			compatible = "google,ZUMA PRO COMET", "google,ZUMA PRO";
		};
	};
};
