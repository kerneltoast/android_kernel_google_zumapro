// SPDX-License-Identifier: GPL-2.0-only
/*
 * Caiman board device tree source
 *
 * Copyright 2024 Google LLC
 */

/dts-v1/;
/plugin/;

#include "zumapro-caimito-common.dtsi"
#include "zumapro-caiman-common.dtsi"
#include "zuma-tokay-4_5V-battery.dtsi"
#include "google-dts-zuma/max777xx-fwupdate.dtsi"
#include "google-dts-zumapro/zumapro-phone-ignss.dtsi"
#include "zumapro-wingboard-charging.dtsi"
#include "zumapro-wingboard-battery.dtsi"
#include "zumapro-caimito-cp-features.dtsi"

/ {
	board_id = <0x60904>;
	board_rev = <0x010002>;
	fragment@boardbase {
		target-path = "/";
		__overlay__ {
			model = "ZUMA PRO CAIMAN DVT 1.0 Wingboard based on ZUMA PRO";
			compatible = "google,ZUMA PRO CAIMAN", "google,ZUMA PRO";
		};
	};
};
