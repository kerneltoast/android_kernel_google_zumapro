// SPDX-License-Identifier: GPL-2.0-only
/*
 * Charging device tree entries for the Caimito platform
 *
 * Copyright 2024 Google LLC
 *
 */

&google_cpm {
	// thermal budgets
	google,mdis-thermal-mitigation =
	<3710000 3571000 3443000 3297000 3162000 3040000 2918000 2810000 2703000
	 2598000 2493000 2330000 2200000 2080000 1968000 1865000 1770000 1684000
	 1595000 1506000 1444000 1382000 1351000 1320000 1273000 1225000>;
	// PD+main-charger, WLC+main-charger
	google,mdis-out0-limits =
	<4000000 3860000 3720000 3580000 3440000 3300000 3160000 3020000 2880000
	 2740000 2600000 2460000 2320000 2180000 2040000 1900000 1760000 1620000
	 1480000 1340000 1200000 1060000 920000  780000  640000  500000
	 1100000 1100000 1100000 1100000 1100000 1100000 1100000 1100000 1100000
	 1100000 1100000 1100000 1050000 1000000 950000  900000  850000  800000
	 750000  700000  650000  600000  550000  500000  450000  400000>;
	// PPS_CP+pca94xx-mains, // WLC_CP+pca94xx-mains
	google,mdis-out1-limits =
	<7413000 7153000 6893000 6633000 6373000 6113000 5853000 5593000 5333000
	 5073000 4813000 4553000 4293000 4033000 3773000 3513000 3253000 2993000
	 2733000 2473000 2213000 1953000 1693000 1433000 1173000 1000000
	 4800000 4600000 4400000 4200000 4000000 3800000 3600000 3400000 3200000
	 3000000 2800000 2600000 2400000 2200000 2000000 1800000 1600000 1400000
	 1200000 1000000 900000  800000  700000  600000  500000  400000>;
};
