// SPDX-License-Identifier: GPL-2.0-only
/*
 * Tokay board device tree source
 *
 * Copyright 2023 Google LLC
 */

/dts-v1/;
/plugin/;

#define ZUMA_BMS_ENABLE_CHG_PROFILE_SWITCH
#include "zumapro-caimito-common.dtsi"
#include "google-dts-zumapro/zumapro-board-cp-s5400-sit-pre-dvt.dtsi"
#include "zumapro-tokay-common.dtsi"
#include "google-dts-zumapro/zumapro-phone-gps.dtsi"
#include "google-dts-zuma/max777xx-fwupdate.dtsi"

/ {
	board_id = <0x60a03>;
	board_rev = <0x010100>;
	fragment@boardbase {
		target-path = "/";
		__overlay__ {
			model = "ZUMA PRO TOKAY EVT 1.1 Broadcom GNSS board based on ZUMA PRO";
			compatible = "google,ZUMA PRO TOKAY", "google,ZUMA PRO";
		};
	};
};
