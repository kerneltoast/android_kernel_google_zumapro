// SPDX-License-Identifier: GPL-2.0-only
/*
 * Komodo Sapwood board device tree source
 *
 * Copyright 2023 Google LLC
 */

/dts-v1/;
/plugin/;

#include "zumapro-ripcurrentpro-sapwood-caimito-common.dtsi"
#include "zuma-ripcurrent24-sapwood-komodo-caiman-common.dtsi"
#include "zuma-komodo-wcharger.dtsi"

/ {
	board_id = <0x60d01>;
	board_rev = <0x010001>;
	fragment@boardbase {
		target-path = "/";
		__overlay__ {
			model = "ZUMA_PRO RipcurrentPro Sapwood KOMODO/CAIMAN configuration board based on ZUMA_PRO";
			compatible = "google,ZUMA_PRO RipcurrentPro Sapwood KOMODO/CAIMAN", "google,ZUMA_PRO";
		};
	};
};
