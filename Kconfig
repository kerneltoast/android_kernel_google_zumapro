## Kconfig
```kconfig
# SPDX-License-Identifier: MIT

menu "GS Display Configuration"
	depends on DRM

config GS_DRM_PANEL_UNIFIED
	tristate "Support for GS Unified panel driver"
	depends on OF && DRM
	select DRM_DISPLAY_HELPER
	select DRM_DISPLAY_DP_HELPER
	help
	  Choose this option to support the unified panel driver framework.
	  This option is designed to be decoupled from DPU code
	  to reduce interdependency. This feature is currently in development
	  and is not meant for use on in-market devices.

config GS_PANEL_SIMPLE
	tristate "Support for simple gs_panel, primarily for simulation"
	depends on GS_DRM_PANEL_UNIFIED
	help
	  Select this option to enable support for the simple (sim) panel

endmenu
```

## Kconfig.ext.caimito
```kconfig
# SPDX-License-Identifier: GPL-2.0

source "$(KCONFIG_EXT_MODULES_PREFIX)private/google-modules/display/common/Kconfig"

source "$(KCONFIG_EXT_MODULES_PREFIX)private/google-modules/fingerprint/qcom/qfs4008/Kconfig"

source "$(KCONFIG_EXT_MODULES_PREFIX)private/google-modules/radio/samsung/s5400/Kconfig"

source "$(KCONFIG_EXT_MODULES_PREFIX)private/google-modules/touch/common/Kconfig"

source "$(KCONFIG_EXT_MODULES_PREFIX)private/google-modules/touch/sec/Kconfig"
```

## Kconfig.ext.comet
```kconfig
# SPDX-License-Identifier: GPL-2.0

source "$(KCONFIG_EXT_MODULES_PREFIX)private/google-modules/radio/samsung/s5400/Kconfig"

source "$(KCONFIG_EXT_MODULES_PREFIX)private/google-modules/touch/common/Kconfig"

source "$(KCONFIG_EXT_MODULES_PREFIX)private/google-modules/touch/sec/Kconfig"
```

## Kconfig.ext_modules
```kconfig
# SPDX-License-Identifier: GPL-2.0

source "$(KCONFIG_EXT_MODULES_PREFIX)private/google-modules/bms/misc/Kconfig"
source "$(KCONFIG_EXT_MODULES_PREFIX)private/google-modules/display/common/Kconfig"
source "$(KCONFIG_EXT_MODULES_PREFIX)private/google-modules/display/samsung/Kconfig"
source "$(KCONFIG_EXT_MODULES_PREFIX)private/google-modules/display/samsung/panel/Kconfig"
source "$(KCONFIG_EXT_MODULES_PREFIX)private/google-modules/fingerprint/qcom/qfs4008/Kconfig"
source "$(KCONFIG_EXT_MODULES_PREFIX)private/google-modules/touch/common/Kconfig"
source "$(KCONFIG_EXT_MODULES_PREFIX)private/google-modules/touch/fts/ftm5/Kconfig"
source "$(KCONFIG_EXT_MODULES_PREFIX)private/google-modules/touch/sec/Kconfig"
source "$(KCONFIG_EXT_MODULES_PREFIX)private/google-modules/trusty/drivers/trusty/Kconfig"
source "$(KCONFIG_EXT_MODULES_PREFIX)private/google-modules/power/reset/Kconfig"

if RADIO_S5300
source "$(KCONFIG_EXT_MODULES_PREFIX)private/google-modules/radio/samsung/s5300/Kconfig"
endif

if RADIO_S5400
source "$(KCONFIG_EXT_MODULES_PREFIX)private/google-modules/radio/samsung/s5400/Kconfig"
endif

source "$(KCONFIG_EXT_MODULES_PREFIX)private/google-modules/wlan/wlan_ptracker/Kconfig"
```

## google-devices/caimito/kunit_defconfig
```kconfig
# Defconfig fragment for Android KUnit targets

# Put test module configs here.

# TODO(b/323263169) Enable this.
# CONFIG_GSA_CORE_KUNIT_TEST=m
```

## google-modules/sensors/hall_sensor/Kconfig
```kconfig
#
# Hall Sensor Driver Support
#

config SENSORS_HALL
	tristate "hall sensor support"
	help
	  Say Y to enable support for hall sensor.
```

## google-modules/soc/gs/drivers/thermal/google/Kconfig
```kconfig
# SPDX-License-Identifier: GPL-2.0-only

config GSOC_PMIC_THERMAL
	tristate "Google LLC. Granville SPMIC thermal driver"
	depends on THERMAL
	help
	  This enables the thermal driver for the Granville PMIC adc thermistors
	  device. It registers thermal zone with multiple trip points.
	  Thermal client sets threshold temperature and  gets updated when
	  a threshold is reached.

config GSOC_PMIC_THERMAL_CAMBRIA
	tristate "Google LLC. Cambria SPMIC thermal driver"
	depends on THERMAL
	help
	  This enables the thermal driver for the Cambria PMIC adc thermistors
	  device. It registers thermal zone with multiple trip points.
	  Thermal client sets threshold temperature and  gets updated when
	  a threshold is reached.

config THERMAL_SENSOR_STS4X
	tristate "Sensiron STS4X temperature sensor."
	depends on THERMAL && I2C
	help
	  This enables the thermal driver for the Digital Temp Sensor (STS4x).
	  It initiates a i2c_driver and registers a thermal zone to get temperature.
```
