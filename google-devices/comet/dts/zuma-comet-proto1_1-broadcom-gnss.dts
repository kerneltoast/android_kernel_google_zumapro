// SPDX-License-Identifier: GPL-2.0-only
/*
 * Comet board device tree source
 *
 * Copyright 2023 Google LLC
 */

/dts-v1/;
/plugin/;

#include "zuma-comet-common.dtsi"
#include "zuma-comet-battery-common.dtsi"
#include "zuma-comet-battery.dtsi"
#include "zuma-comet-charging.dtsi"
#include "zuma-comet-wcharger-proto.dtsi"
#include "zuma-comet-usecases.dtsi"
#include "zuma-comet-bcl.dtsi"
#include "zuma-comet-typec.dtsi"
#include "zumapro/zumapro-board-cp-s5400-sit.dtsi"
#include "zumapro/zumapro-board-cp-s5400-sit-pre-dvt.dtsi"
#include "zumapro/zumapro-cp-s5400-proto.dtsi"
#include "zuma/zuma-board-pcie-cp-s5400-a0.dtsi"
#include "zumapro/zumapro-phone-gps.dtsi"
#include "zumapro/zumapro-cp-s5400-thermal-zone.dtsi"
#include "zuma-comet-touch.dtsi"
#include "zuma-comet-outer-touch.dtsi"
#include "zuma-comet-audio.dtsi"
#include "zuma-comet-camera-pmic.dtsi"
#include "zuma-comet-camera.dtsi"
#include "zuma-comet-wlan.dtsi"
#include "zuma-comet-fingerprint.dtsi"
#include "zuma-comet-uwb.dtsi"
#include "zuma-comet-wifi-4390a0.dtsi"

/ {
	board_id = <0x40602>;
	board_rev = <0x010102>;
	fragment@boardbase {
		target-path = "/";
		__overlay__ {
			model = "ZUMA COMET PROTO 1.1 Broadcom GNSS board based on ZUMA";
			compatible = "google,ZUMA COMET", "google,ZUMA";
		};
	};
};
