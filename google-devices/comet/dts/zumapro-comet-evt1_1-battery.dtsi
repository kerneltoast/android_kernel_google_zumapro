// SPDX-License-Identifier: GPL-2.0-only
/*
 * Comet board device tree source
 *
 * Copyright 2024 Google LLC
 */
&google_battery {
	google,chg-battery-capacity = <4560>;

	google,aact-cv-limits = <4100000 4200000 4250000 4270000 4300000 4350000 4500000>;
	google,aact-temp-limits = <0 100 200 420 460 480 550>;
	google,chg-aact-ecc = <0 300 1000>;
	google,aact-cc-limits = <
		 30  30  10  10  10   0   0
		 50  50  30  30  30  30  30
		100 100 100 100  70  70  50
		 80  80  80  50  50  50  50
		 50  50  50   0   0   0   0
		 30   0   0   0   0   0   0
		 30  30  10  10  10   0   0
		 50  50  30  30  30  30  30
		 95  95  95  95  70  70  50
		 80  80  80  50  50  50  50
		 50  50  50   0   0   0   0
		 30   0   0   0   0   0   0
		 30  30  10  10  10   0   0
		 50  50  30  30  30  30  30
		 90  90  90  90  70  70  50
		 80  80  80  50  50  50  50
		 50  50  50   0   0   0   0
		 30   0   0   0   0   0   0
	>;

	/* 90% after 600 cycles, 80% after 1000 cycles */
	google,aacr-algo = <3>;
	google,aacr-cliff-capacity-rate = <80>;
	google,aacr-cycle-max = <1000>;

	google,batt-id-1-atl {
		google,batt-id = <1>;
		google,aacr-ref-cycles = <599 600 1000>;
		google,aacr-ref-fade10 = <  0 100  100>;
		google,aafv-ref-cycles = <200 400 600 800 1000 1001>;
		google,aafv-ref-offset = <  0  20  40  60   80  100>;
	};
	google,batt-id-2-cos {
		google,batt-id = <2>;
		google,aacr-ref-cycles = <599 600 1000>;
		google,aacr-ref-fade10 = <  0 100  100>;
		google,aafv-ref-cycles = <200 400 600 800 1000 1001>;
		google,aafv-ref-offset = <  0  20  40  60   80  100>;
	};
};
