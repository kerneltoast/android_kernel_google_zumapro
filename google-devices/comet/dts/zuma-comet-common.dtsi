// SPDX-License-Identifier: GPL-2.0-only
/*
 * Zuma24 board device tree source
 *
 * Copyright 2023 Google LLC
 */

#include "zuma/zuma-common.dtsi"

#include "zuma-comet-aoc.dtsi"
#include "zuma/zuma-ripcurrent-gsa-gsc.dtsi"
#include "zuma/zuma-ripcurrent-pmic.dtsi"
#include "zuma/zuma-ripcurrent-touch.dtsi"
#include "zuma/zuma-board-bluetooth.dtsi"
#include "zumapro/zumapro-rmem-proto.dtsi"
#include "zuma-comet-display.dtsi"
#include "zuma-comet-ese.dtsi"
#include "zuma-comet-nfc.dtsi"
#include "zuma/zuma-board-pcie.dtsi"
#include "zuma-comet-hall-sensor.dtsi"
#include "zuma-comet-haptics.dtsi"
#include "zuma/zuma-ripcurrent-bluetooth.dtsi"
#include "zuma-comet-pmic.dtsi"
#include "zuma-comet-thermal.dtsi"
#include "zuma-comet-usb.dtsi"
#include "zuma/gs101-faceauth-dma-heap.dtsi"
