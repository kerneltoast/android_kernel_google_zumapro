// SPDX-License-Identifier: GPL-2.0-only
/*
 * Charging device tree entries specific to Sapwood Tokay devices
 *
 * Copyright 2022 Google LLC
 *
 */

&pinctrl_0 {
	dc_charger_irq: dc-charger-irq {
		samsung,pins = "gpa7-4"; /* XEINT_18 (PLC_INT_L) */
		samsung,pin-function = <EXYNOS_PIN_FUNC_EINT>;
		samsung,pin-pud = <EXYNOS_PIN_PULL_UP>;
	};
};

&pca9468_dc {
	status = "okay";
	pinctrl-0 = <&dc_charger_irq>;

	interrupt-parent = <&gpa7>;
	pca9468,irq-gpio = <&gpa7 4 GPIO_ACTIVE_LOW>; /* PLC_INT_L */

	pca9468,input-current-limit = <2700000>; /* 5.4A max */
};
