// SPDX-License-Identifier: GPL-2.0-only
/*
 * Tokay board device tree source
 *
 * Copyright 2023 Google LLC
 */

/dts-v1/;
/plugin/;

#define ZUMA_BMS_PROTO_EVT10_MODEL
#define ZUMA_BMS_ENABLE_CHG_PROFILE_SWITCH
#define ZUMA_TOKAY_WINGBOARD_CAMERA
#include "zumapro-caimito-common.dtsi"
#include "google-dts-zumapro/zumapro-board-cp-s5400-sit-pre-dvt.dtsi"
#include "zumapro-tokay-common.dtsi"
#include "google-dts-zumapro/zumapro-phone-gps.dtsi"
#include "zumapro-wingboard-charging.dtsi"
#include "zumapro-wingboard-battery.dtsi"
#include "zumapro-tokay-wifi-4390a0.dtsi"

/ {
	board_id = <0x60a03>;
	board_rev = <0x010002>;
	fragment@boardbase {
		target-path = "/";
		__overlay__ {
			model = "ZUMA PRO TOKAY EVT 1.0 Wingboard based on ZUMA PRO";
			compatible = "google,ZUMA PRO TOKAY", "google,ZUMA PRO";
		};
	};
};
