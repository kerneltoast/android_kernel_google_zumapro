// SPDX-License-Identifier: GPL-2.0-only
/*
 * Tokay board device tree source
 *
 * Copyright 2024 Google LLC
 */

/dts-v1/;
/plugin/;

#define ZUMA_TOKAY_WINGBOARD_CAMERA
#include "zumapro-caimito-common.dtsi"
#include "zumapro-tokay-common.dtsi"
#include "zuma-tokay-4_5V-battery.dtsi"
#include "google-dts-zuma/max777xx-fwupdate.dtsi"
#include "google-dts-zumapro/zumapro-phone-ignss.dtsi"
#include "zumapro-wingboard-charging.dtsi"
#include "zumapro-wingboard-battery.dtsi"
#include "zumapro-caimito-cp-features.dtsi"

/ {
	board_id = <0x60a04>;
	board_rev = <0x010001>;
	fragment@boardbase {
		target-path = "/";
		__overlay__ {
			model = "ZUMA PRO TOKAY DVT 1.0 Wingboard based on ZUMA PRO";
			compatible = "google,ZUMA PRO TOKAY", "google,ZUMA PRO";
		};
	};
};
