// SPDX-License-Identifier: GPL-2.0-only
/*
 * Tokay board device tree source
 *
 * Copyright 2023 Google LLC
 */

#include "zuma-tokay-battery.dtsi"
#include "zuma-tokay-charging.dtsi"
#include "zuma-tokay-wcharger.dtsi"
#include "zuma-tokay-usecases.dtsi"
#include "zuma-tokay-audio.dtsi"
#include "zuma-tokay-camera.dtsi"
#include "zuma-tokay-display.dtsi"
#include "zuma-tokay-ldaf.dtsi"
#include "zuma-tokay-pmic.dtsi"
#include "zuma-tokay-touch.dtsi"
#include "zumapro-tokay-bcl.dtsi"
