// SPDX-License-Identifier: GPL-2.0-only
/*
 * Zumapro board device tree source
 *
 * Copyright 2023 Google LLC
 */

#include "google-dts-zumapro/zumapro-common.dtsi"
#include "google-dts-ripcurrent/zuma-ripcurrent-touch.dtsi"
#include "zumapro-ripcurrentpro-audio.dtsi"
#include "zumapro-ripcurrentpro-display.dtsi"
#include "zumapro-ripcurrentpro-haptics.dtsi"
#include "google-dts-zumapro/zumapro-board-pcie.dtsi"
#include "google-dts-zuma/zuma-board-wlan.dtsi"
#include "zumapro-ripcurrentpro-cp-s5400-sit.dtsi"
#include "google-dts-ripcurrent/zuma-ripcurrent-sbbm.dtsi"
#include "zumapro-dma-heap.dtsi"

/*
#include "zuma-ripcurrent-battery.dtsi"
#include "zuma-ripcurrent-camera-pmic.dtsi"
#include "zuma-ripcurrent-camera.dtsi"
#include "zuma-ripcurrent-gsa-gsc.dtsi"
#include "zuma-ripcurrent-pmic.dtsi"
#include "zuma-ripcurrent-usb.dtsi"
#include "zuma-ripcurrent-usecases.dtsi"
#include "google-dts-zuma/zuma-board-bluetooth.dtsi"
#include "google-dts-zuma/zuma-board-ese.dtsi"
#include "google-dts-zuma/zuma-board-nfc.dtsi"
#include "google-dts-zuma/zuma-board-udfps.dtsi"
#include "zuma-ripcurrent-audio.dtsi"
#include "zuma-ripcurrent-uwb.dtsi"
#include "zuma-ripcurrent-thermal.dtsi"
#include "zuma-ripcurrent-bcl.dtsi"
#include "zuma-ripcurrent-bluetooth.dtsi"
#include "zuma-ripcurrent-bluetooth-offmode.dtsi"
#include "google-dts-zuma/zuma-typec.dtsi"
*/
