// SPDX-License-Identifier: GPL-2.0-only
/*
 * Battery device tree entries
 *
 * Copyright 2023 Google LLC
 *
 */

max77779,config {

	/* 3501_1_040224_BC79_RC2_updated_send_googlemod.raw.model.ini, b/332393177#comment5 */
	max77779,atl-1k {
		max77779,batt-id-kohm = <1>;
		max77779,model-version = <11>;
		max77779,force-reset-model-data;
		max77779,fg-model = /bits/ 16 <
			0x96b0 0xad50 0xb320 0xb940 0xbae0 0xbce0 0xbe50 0xbfa0
			0xc2c0 0xc5f0 0xc980 0xcd20 0xd0c0 0xd470 0xd710 0xde00
			0x0020 0x0030 0x05c0 0x1430 0x1070 0x1370 0x1300 0x1000
			0x05b0 0x07a0 0x06f0 0x08f0 0x04f0 0x09a0 0x05f0 0x05f0
		>;
		max77779,fg-params = /bits/ 16 <
			/* 0x00C0 */    0xc1b0  /* nnvcfg0 */
			/* 0x00B6 */    0x083b  /* nrelaxcfg */
			/* 0x009F */    0x660e  /* nLearnCFG */
			/* 0x000C */    0x4207  /* Config */
			/* 0x00AB */    0x0081  /* Config2 */
			/* 0x00BC */    0x5f00  /* nFullSOCThr */
			/* 0x00A9 */    0x07de  /* nfullcaprep */
			/* 0x00B3 */    0x07de  /* ndesigncap */
			/* 0x0046 */    0x0c80  /* dPacc */
			/* 0x00A5 */    0x07de  /* nfullcapnom */
			/* 0x00C6 */    0xa55a  /* nVEmpty */
			/* 0x00A0 */    0x3203  /* nQRTable00 */
			/* 0x00A1 */    0x1501  /* nQRTable10 */
			/* 0x00A2 */    0x0680  /* nQRTable20 */
			/* 0x00A3 */    0x0580  /* nQRTable30 */
			/* 0x00A6 */    0x05d0  /* nRCOMP0 */
			/* 0x00A7 */    0x2202  /* nTempCo */
			/* 0x009C */    0x0278  /* nichgterm */
			/* 0x00B2 */    0x3870  /* nmisccfg */
			/* 0x009E */    0x0400  /* nModelCfg */
			/* 0x00CA */    0xc8ff  /* nThermCfg */
			/* 0x009D */    0xcea4  /* nFilterCfg */
		>;
	};

	/* KM4_COS_RC2_BC79_2mOhm_3502_2_071823_20231219.model.ini.txt, b/317137025#comment1 */
	max77779,cos-2k {
		max77779,batt-id-kohm = <2>;
		max77779,model-version = <9>;
		max77779,force-reset-model-data;
		max77779,fg-model = /bits/ 16 <
			0xa510 0xb6d0 0xb880 0xba30 0xbbe0 0xbdc0 0xbef0 0xc060
			0xc400 0xc750 0xcaf0 0xce70 0xd1e0 0xd8c0 0xdaa0 0xde60
			0x0120 0x0c20 0x0d30 0x1010 0x0f60 0x1240 0x11a0 0x0ce0
			0x06d0 0x06f0 0x06d0 0x0740 0x06d0 0x09d0 0x0680 0x0680
		>;
		max77779,fg-params = /bits/ 16 <
			/* 0x00C0 */	0xc1b0	/* nNVCfg0 */
			/* 0x00B6 */	0x043c	/* RelaxCFG */
			/* 0x009F */	0x260e	/* nLearnCFG */
			/* 0x000C */	0x4207	/* Config */
			/* 0x00AB */	0x0080	/* Config2 */
			/* 0x00BC */	0x5f00	/* nFullSOCthr */
			/* 0x00A9 */	0x07e0	/* nFullCAPRep */
			/* 0x00B3 */	0x07e0	/* nDesignCap */
			/* 0x0046 */	0x0C80	/* dPacc */
			/* 0x00A5 */	0x07e0	/* nFullCAPNom */
			/* 0x00C6 */	0xa55a	/* nV_empty */
			/* 0x00A0 */	0x3400	/* nQRTable00 */
			/* 0x00A1 */	0x1780	/* nQRTable10 */
			/* 0x00A2 */	0x0900	/* nQRTable20 */
			/* 0x00A3 */	0x0880	/* nQRTable30 */
			/* 0x00A6 */	0x04e0	/* nRCOMP0 */
			/* 0x00A7 */	0x1c02	/* nTempCo */
			/* 0x009C */	0x0278	/* nIChgTerm */
			/* 0x00B2 */	0x3870	/* nMiscCFG */
			/* 0x009E */	0x0400	/* nModelCfg */
			/* 0x00CA */	0xC8FF	/* nThermCfg */
			/* 0x009D */	0xCEA4	/* nFilterCfg */
		>;
	};

	/* KM4_LWN_RC2_BC79_2mOhm_3503_1_071723_20231219.model.ini.txt, b/317137025#comment1 */
	max77779,lwn-4k {
		max77779,batt-id-kohm = <4>;
		max77779,model-version = <9>;
		max77779,force-reset-model-data;
		max77779,fg-model = /bits/ 16 <
			0xa500 0xb760 0xb8c0 0xbaa0 0xbd30 0xbd90 0xbe30 0xbf20
			0xbf60 0xc0c0 0xc280 0xc3e0 0xcac0 0xd050 0xd800 0xddc0
			0x0130 0x1200 0x0d30 0x0e30 0x2b10 0x1020 0x1240 0x2220
			0x0eb0 0x0ef0 0x05f0 0x07f0 0x06c0 0x06f0 0x0670 0x0670
		>;
		max77779,fg-params = /bits/ 16 <
			/* 0x00C0 */	0xc1b0	/* nNVCfg0 */
			/* 0x00B6 */	0x043c	/* RelaxCFG */
			/* 0x009F */	0x260e	/* nLearnCFG */
			/* 0x000C */	0x4207	/* Config */
			/* 0x00AB */	0x0080	/* Config2 */
			/* 0x00BC */	0x5f00	/* nFullSOCthr */
			/* 0x00A9 */	0x07e0	/* nFullCAPRep */
			/* 0x00B3 */	0x07e0	/* nDesignCap */
			/* 0x0046 */	0x0C80	/* dPacc */
			/* 0x00A5 */	0x07e0	/* nFullCAPNom */
			/* 0x00C6 */	0xa55a	/* nV_empty */
			/* 0x00A0 */	0x2f8e	/* nQRTable00 */
			/* 0x00A1 */	0x1a00	/* nQRTable10 */
			/* 0x00A2 */	0x0f00	/* nQRTable20 */
			/* 0x00A3 */	0x0b00	/* nQRTable30 */
			/* 0x00A6 */	0x0550	/* nRCOMP0 */
			/* 0x00A7 */	0x1f02	/* nTempCo */
			/* 0x009C */	0x0278	/* nIChgTerm */
			/* 0x00B2 */	0x3870	/* nMiscCFG */
			/* 0x009E */	0x0400	/* nModelCfg */
			/* 0x00CA */	0xC8FF	/* nThermCfg */
			/* 0x009D */	0xCEA4	/* nFilterCfg */
		>;
	};
};
