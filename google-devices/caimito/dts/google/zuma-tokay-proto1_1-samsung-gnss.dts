// SPDX-License-Identifier: GPL-2.0-only
/*
 * Tokay board device tree source
 *
 * Copyright 2023 Google LLC
 */

/dts-v1/;
/plugin/;

#include "zuma-caimito-common.dtsi"
#include "zuma-tokay-common.dtsi"
#include "google-dts-zuma/zuma-cp-s5400-phone-gnss.dtsi"
#include "zuma-caimito-gnss-samsung.dtsi"
#include "zuma-tokay-wifi-4390a0.dtsi"

/ {
	board_id = <0x40a02>;
	board_rev = <0x010100>;
	fragment@boardbase {
		target-path = "/";
		__overlay__ {
			model = "ZUMA TOKAY Proto 1.1 Samsung GNSS board based on ZUMA";
			compatible = "google,ZUMA TOKAY", "google,ZUMA";
		};
	};
};
