// SPDX-License-Identifier: GPL-2.0-only

/dts-v1/;
/plugin/;

/ {
	compatible = "google,ZUMAPRO DPM-user", "google,ZUMAPRO DPM-user";
};

#include "zuma/zuma-dpm-user.dtsi"
#include "zuma/avf-dpm-user.dtsi"
