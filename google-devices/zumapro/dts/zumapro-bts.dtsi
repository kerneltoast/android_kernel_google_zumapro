// SPDX-License-Identifier: GPL-2.0-only
/*
 * SAMSUNG EXYNOS SoC BTS device tree source
 *
 * Copyright (c) 2023 Samsung Electronics Co., Ltd.
 *		http://www.samsung.com
 *
 * SAMSUNG EXYNOS SoC BTS device nodes are listed in this file.
 * EXYNOS based board files should include this file.
 *
 */

#include "zuma/zuma-bts.dtsi"
